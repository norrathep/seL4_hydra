## prover/apps/fuel-level-app/Kconfig
```kconfig
#
# Copyright 2014, NICTA
#
# This software may be distributed and modified according to the terms of
# the BSD 2-Clause license. Note that NO WARRANTY is provided.
# See "LICENSE_BSD2.txt" for details.
#
# @TAG(NICTA_BSD)
#

menuconfig FUEL_LEVEL_APP
    bool "Fuel Level App"
    default n
    depends on LIB_SEL4 && (LIB_MUSL_C || LIB_SEL4_C)
    help
        Contains the app that display fuel level.
```

## prover/apps/hydra-app/Kconfig
```kconfig
#
# Copyright 2014, NICTA
#
# This software may be distributed and modified according to the terms of
# the BSD 2-Clause license. Note that NO WARRANTY is provided.
# See "LICENSE_BSD2.txt" for details.
#
# @TAG(NICTA_BSD)
#

menuconfig APP_HYDRA_APP
    bool "Dummy app for Hydra"
    default n
    depends on LIB_SEL4 && (LIB_MUSL_C || LIB_SEL4_C) && LIB_SEL4_SIMPLE && LIB_SEL4_VKA && LIB_SEL4_ALLOCMAN && \
	LIB_SEL4_VSPACE && LIB_SEL4_PLAT_SUPPORT && LIB_SEL4_UTILS && LIB_CPIO && LIB_ELF && LIB_ATTEST
    help
        Contains the app that will be attested.
```

## prover/apps/hydra/Kconfig
```kconfig
#
# Copyright 2015, NICTA
#
# This software may be distributed and modified according to the terms of
# the BSD 2-Clause license. Note that NO WARRANTY is provided.
# See "LICENSE_BSD2.txt" for details.
#
# @TAG(NICTA_BSD)
#

menuconfig APP_HYDRA
    bool "Hydra - Hybrid design for remote attestation"
    default n
    depends on LIB_SEL4 && (LIB_MUSL_C || LIB_SEL4_C) && LIB_SEL4_SIMPLE && LIB_SEL4_VKA && LIB_SEL4_ALLOCMAN && LIB_SEL4_VSPACE \
	&& LIB_SEL4_PLAT_SUPPORT && LIB_SEL4_UTILS && LIB_CPIO && LIB_ELF && LIB_SEL4_BENCH && LIB_CRYPTO && LIB_ATTEST \
        && LIB_LWIP && LIB_ETHIF && LIB_PLATSUPPORT
    help
       Simple example of how to use the seL4 API and libraries - version 4. 

config SOS_NETMASK
    string "Network mask"
    depends on APP_HYDRA
    default "225.225.225.0"

config SOS_IP
    string "IP address"
    depends on APP_HYDRA
    default "192.168.168.2"

config SOS_GATEWAY
    string "Gateway IP address"
    depends on APP_HYDRA
    default "192.168.168.1"
```

## prover/apps/update-benchmark/Kconfig
```kconfig
#
# Copyright 2015, NICTA
#
# This software may be distributed and modified according to the terms of
# the BSD 2-Clause license. Note that NO WARRANTY is provided.
# See "LICENSE_BSD2.txt" for details.
#
# @TAG(NICTA_BSD)
#

menuconfig APP_UPDATE_BENCHMARK
    bool "update benchmark"
    default n
    depends on LIB_SEL4 && (LIB_MUSL_C || LIB_SEL4_C) && LIB_SEL4_SIMPLE && LIB_SEL4_VKA && LIB_SEL4_ALLOCMAN && LIB_SEL4_VSPACE \
	&& LIB_SEL4_PLAT_SUPPORT \
	&& LIB_SEL4_UTILS && LIB_CPIO && LIB_ELF && LIB_SEL4_BENCH && LIB_CRYPTO \
        && LIB_UPDATE && LIB_PLATSUPPORT
        #&& LIB_PLATSUPPORT && LIB_UPDATE
    help
       Benchmark update process
```

## prover/libs/libattest/Kconfig
```kconfig
#
# Copyright 2014, NICTA
#
# This software may be distributed and modified according to the terms of
# the BSD 2-Clause license. Note that NO WARRANTY is provided.
# See "LICENSE_BSD2.txt" for details.
#
# @TAG(NICTA_BSD)
#

config LIB_ATTEST
    bool "attestation lib"
    default y
    depends on LIB_CRYPTO && LIB_SEL4_BENCH && HAVE_LIBC
    help
        Build attestation lib.
```

## prover/libs/libupdate/Kconfig
```kconfig
config LIB_UPDATE
    bool "library for software update"
    default y
    depends on HAVE_LIBC && LIB_CRYPTO
    help
        Build software update lib.
```
